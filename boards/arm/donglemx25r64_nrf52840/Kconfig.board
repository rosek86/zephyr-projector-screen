## boards/arm/donglemx25r64_nrf52840/Kconfig.board
```kconfig
# DONGLE MX25R64 NRF52840 board configuration

# Copyright (c) 2016 Nordic Semiconductor ASA
# SPDX-License-Identifier: Apache-2.0

config BOARD_DONGLEMX25R64_NRF52840
	bool "DONGLE MX25R64 NRF52840"
	depends on SOC_NRF52840_QIAA
```

## boards/arm/donglemx25r64_nrf52840/Kconfig.defconfig
```kconfig
# DONGLE MX25R64 NRF52840 board configuration

# Copyright (c) 2016 Nordic Semiconductor ASA
# SPDX-License-Identifier: Apache-2.0

if BOARD_DONGLEMX25R64_NRF52840

config BOARD
	default "donglmx25r64_nrf52840"

config BT_CTLR
	default BT

endif # BOARD_DONGLEMX25R64_NRF52840
```

## boards/arm/donglemx25r64_nrf52840/donglemx25r64_nrf52840_defconfig
```kconfig
# SPDX-License-Identifier: Apache-2.0

CONFIG_SOC_SERIES_NRF52X=y
CONFIG_SOC_NRF52840_QIAA=y
CONFIG_BOARD_DONGLEMX25R64_NRF52840=y

# Enable MPU
CONFIG_ARM_MPU=y

# Enable hardware stack protection
CONFIG_HW_STACK_PROTECTION=y

# Enable RTT
CONFIG_USE_SEGGER_RTT=y

# enable GPIO
CONFIG_GPIO=y

# enable uart driver
CONFIG_SERIAL=y

# enable console
CONFIG_CONSOLE=y
CONFIG_UART_CONSOLE=y

# additional board options
CONFIG_GPIO_AS_PINRESET=y
CONFIG_NFCT_PINS_AS_GPIOS=n
CONFIG_NORDIC_QSPI_NOR_STACK_WRITE_BUFFER_SIZE=16

CONFIG_PINCTRL=y
```

## child_image/mcuboot/boards/donglemx25r64_nrf52840.conf
```kconfig
# CONFIG_NFCT_PINS_AS_GPIOS=n
# CONFIG_NORDIC_QSPI_NOR_STACK_WRITE_BUFFER_SIZE=16
```
